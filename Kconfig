## Kconfig
```kconfig
config ZMK_OS_LAYER
    bool "OS Layer switching based on BLE profile"
    default n

if ZMK_OS_LAYER

config ZMK_OS_LAYER_PROFILE_0
    int "Layer for BLE profile 0 (-1 = none)"
    default -1
    range -1 31

config ZMK_OS_LAYER_PROFILE_1
    int "Layer for BLE profile 1 (-1 = none)"
    default -1
    range -1 31

config ZMK_OS_LAYER_PROFILE_2
    int "Layer for BLE profile 2 (-1 = none)"
    default -1
    range -1 31

config ZMK_OS_LAYER_PROFILE_3
    int "Layer for BLE profile 3 (-1 = none)"
    default -1
    range -1 31

config ZMK_OS_LAYER_PROFILE_4
    int "Layer for BLE profile 4 (-1 = none)"
    default -1
    range -1 31

endif

config ZMK_DAX_SYSTEM_RPC
    bool "Reboot the keyboard, normally or into the bootloader, over custom Studio RPC"
    default n
    depends on ZMK_STUDIO
    help
      The dax_system subsystem. Anyone the Studio RPC answers can then reboot the
      keyboard into its UF2 bootloader, so it is off unless a keyboard asks for it.

config ZMK_TRACKBALL_SETTINGS
    bool "Runtime trackball sensor settings (CPI) in the dax settings layer"
    default n
    depends on PAW3222
    select ZMK_DAX_SETTINGS

config ZMK_DAX_HOLD_MACRO
    bool "Behavior that plays one dax macro on press and another on release"
    default y
    depends on DT_HAS_DAX_BEHAVIOR_HOLD_MACRO_ENABLED
    depends on ZMK_DAX_MACRO

config ZMK_DAX_SETTINGS
    bool
    select SETTINGS
    help
      The dax settings layer (include/dax/settings.h): values a feature edits at
      runtime, kept in RAM until saved. Selected by the features that use it.

if ZMK_DAX_SETTINGS

# Settings load on the main thread. zmk-feature-custom-settings, which these settings replace,
# saw a split central overflow the 1024-byte default main stack during that load and raised it
# this way. configdefault only raises the default; a board or user setting still wins.
configdefault MAIN_STACK_SIZE
    default 2048

config ZMK_DAX_SETTINGS_VALUE_MAX_SIZE
    int "Most bytes one setting slot holds"
    default 288 if ZMK_DAX_MACRO
    default 128
    help
      With ZMK_DAX_MACRO on, at least 1 + ZMK_DAX_MACRO_NAME_MAX +
      ZMK_DAX_MACRO_MAX_BYTES, the largest macro record; the build stops otherwise.

config ZMK_DAX_SETTINGS_TEST
    bool "Let a test read an owner's settings from flash again (tests only)"

config ZMK_DAX_SETTINGS_STUDIO_RPC
    bool "List and edit the typed dax settings over custom Studio RPC"
    default y
    depends on ZMK_STUDIO
    help
      The dax_settings subsystem (proto/dax/settings/settings.proto), through which
      a client edits the trackball and gesture settings.

endif

config ZMK_DAX_POINTER
    bool "Pointer processors edited at runtime"
    default y
    depends on DT_HAS_DAX_INPUT_PROCESSOR_POINTER_ENABLED
    depends on ZMK_POINTING
    select ZMK_DAX_SETTINGS
    help
      dax,input-processor-pointer: scaling, rotation, swap, inversion, scrolling and a layer
      held while the device moves, each a dax setting of the dax_pointer owner.

config ZMK_DAX_POINTER_TEST
    bool "Edit the pointer settings shortly after boot (tests only)"
    depends on ZMK_DAX_POINTER

choice ZMK_DAX_POINTER_TEST_SCENARIO
    prompt "What the test writes"
    depends on ZMK_DAX_POINTER_TEST

config ZMK_DAX_POINTER_TEST_EDIT_DISCARD
    bool "Writes in RAM, then a discard"

config ZMK_DAX_POINTER_TEST_RELOAD
    bool "Saves, then reads the settings from flash again"
    select ZMK_DAX_SETTINGS_TEST

config ZMK_DAX_POINTER_TEST_REORDER
    bool "Moves the layers so that positions and ids differ"
    select ZMK_KEYMAP_LAYER_REORDERING

endchoice

config ZMK_DAX_COMBO
    bool "Combos matched by ZMK's combo code, edited at runtime"
    default n
    depends on !ZMK_SPLIT || ZMK_SPLIT_ROLE_CENTRAL
    select ZMK_DAX_SETTINGS
    select ZMK_BEHAVIOR_LOCAL_IDS
    help
      Combos defined by a dax,runtime-combo-defaults node and edited over the
      dax_combo Studio RPC. They are matched by a copy of ZMK's own combo code,
      placed at the same point in the event chain, so they work with hold-taps
      the way zmk,combos do.

if ZMK_DAX_COMBO

config ZMK_DAX_COMBO_STUDIO_RPC
    bool "Edit combos over custom Studio RPC"
    default y
    depends on ZMK_STUDIO

config ZMK_DAX_COMBO_MAX_COMBOS
    int "Combo slots"
    default 8
    range 1 16

config ZMK_DAX_COMBO_MAX_KEYS_PER_COMBO
    int "Key positions per combo"
    default 16
    range 1 16

config ZMK_DAX_COMBO_DEFAULT_TIMEOUT_MS
    int "Default combo timeout"
    default 50
    range 1 65535

config ZMK_DAX_COMBO_DEFAULT_REQUIRE_PRIOR_IDLE_MS
    int "Default combo require-prior-idle time"
    default 0
    range 0 65535
    help
      A combo is skipped if a non-modifier key was tapped within this many
      milliseconds before its first key. 0 disables the check.

config ZMK_DAX_COMBO_TEST
    bool "Write combos shortly after boot (tests only)"

choice ZMK_DAX_COMBO_TEST_SCENARIO
    prompt "What the test writes"
    depends on ZMK_DAX_COMBO_TEST

config ZMK_DAX_COMBO_TEST_OVERRIDES
    bool "Overlapping combos and per-combo overrides"

config ZMK_DAX_COMBO_TEST_DEFAULTS
    bool "Edits, deletes and resets of devicetree defaults"

config ZMK_DAX_COMBO_TEST_DISCARD
    bool "Memory-only writes, then a discard"

config ZMK_DAX_COMBO_TEST_PENDING
    bool "An edit while a combo is held"

config ZMK_DAX_COMBO_TEST_INVALID
    bool "A combo with a key position outside the keymap"

config ZMK_DAX_COMBO_TEST_RELOAD
    bool "Saves, then reads the combos from flash again"
    select ZMK_DAX_SETTINGS_TEST

endchoice

endif

config ZMK_DAX_MACRO
    bool "Macros in fixed slots, edited at runtime"
    default n
    depends on !ZMK_SPLIT || ZMK_SPLIT_ROLE_CENTRAL
    select ZMK_DAX_SETTINGS
    select ZMK_BEHAVIOR_LOCAL_IDS
    help
      Macros played by `&dax_macro <slot>`, with a dax,runtime-macro-defaults node
      as defaults, edited over the dax_macro Studio RPC. A slot is one record in the
      dax settings layer, and every edit stays in RAM until a save.

if ZMK_DAX_MACRO

config ZMK_DAX_MACRO_STUDIO_RPC
    bool "Edit macros over custom Studio RPC"
    default y
    depends on ZMK_STUDIO

config ZMK_DAX_MACRO_COUNT
    int "Macro slots"
    default 8
    range 1 16

config ZMK_DAX_MACRO_NAME_MAX
    int "Most bytes in a macro's name"
    default 24
    range 1 31

config ZMK_DAX_MACRO_MAX_BYTES
    int "Most bytes in a macro's encoded steps, with their version byte"
    default 256
    range 2 1024

config ZMK_DAX_MACRO_PLAY_QUEUE
    int "Plays that wait while a macro plays"
    default 8
    range 1 64
    help
      A play that finds the queue full is dropped, with a warning in the log.

config ZMK_DAX_MACRO_DEFAULT_TAP_MS
    int "Default time a macro holds each key it taps"
    default 30
    range 0 10000

config ZMK_DAX_MACRO_TEST
    bool "Edit macros shortly after boot (tests only)"

choice ZMK_DAX_MACRO_TEST_SCENARIO
    prompt "What the test writes"
    depends on ZMK_DAX_MACRO_TEST

config ZMK_DAX_MACRO_TEST_DEFAULTS
    bool "Nothing; logs what the slots show"

config ZMK_DAX_MACRO_TEST_EDIT_DISCARD
    bool "Creates, renames, deletes and step edits in RAM, then a discard"

config ZMK_DAX_MACRO_TEST_RELOAD
    bool "Saves, then reads the macros from flash again"
    select ZMK_DAX_SETTINGS_TEST

endchoice

endif

config ZMK_DAX_GESTURE
    bool "Stroke gestures for a pointing device"
    default y
    depends on DT_HAS_DAX_INPUT_PROCESSOR_GESTURE_ENABLED
    depends on ZMK_POINTING

if ZMK_DAX_GESTURE

config ZMK_DAX_GESTURE_MAX_GESTURES
    int "Gesture slots across all profiles"
    default 16
    range 1 64
    help
      Room for the devicetree gestures plus the ones added at runtime.

config ZMK_DAX_GESTURE_RUNTIME
    bool "Edit gesture tuning, profiles and gestures in the dax settings layer"
    default y
    depends on ZMK_BEHAVIOR_LOCAL_IDS
    select ZMK_DAX_SETTINGS

config ZMK_DAX_GESTURE_TEST
    bool "Edit gestures shortly after boot (tests only)"
    depends on ZMK_DAX_GESTURE_RUNTIME

config ZMK_DAX_GESTURE_RPC
    bool "Report recognition and capture patterns over custom Studio RPC"
    default y
    depends on ZMK_STUDIO_RPC

endif
```

## dts/bindings/behaviors/dax,behavior-encoder.yaml
```yaml
# Copyright (c) 2026 wadackel
# SPDX-License-Identifier: MIT

description: |
  Plays a binding for each step an encoder turns, one for clockwise and one for counterclockwise,
  each held for tap-ms. Put an instance in a layer's sensor-bindings. These are the defaults: a
  settings app changes the binding of each sensor, layer and direction at runtime through the
  `dax_encoder` dax settings (proto/dax/settings/settings.proto lists the keys).

      dax_enc_scroll: dax_enc_scroll {
          compatible = "dax,behavior-encoder";
          #sensor-binding-cells = <0>;
          cw-binding = <&msc SCRL_UP>;
          ccw-binding = <&msc SCRL_DOWN>;
          tap-ms = <20>;
      };

  Name the node with a `dax_enc_` prefix: settings apps tell these behaviors apart from the ones a
  key can play by it.

compatible: "dax,behavior-encoder"

properties:
  "#sensor-binding-cells":
    type: int
    required: true
    const: 0
  cw-binding:
    type: phandle-array
    required: true
    specifier-space: binding
    description: The binding a clockwise step plays, such as <&kp C_VOL_UP>.
  ccw-binding:
    type: phandle-array
    required: true
    specifier-space: binding
    description: The binding a counterclockwise step plays.
  tap-ms:
    type: int
    default: 5
    description: How long each step holds its binding, 0 to 1000.
```

## dts/bindings/behaviors/dax,behavior-hold-macro.yaml
```yaml
# Copyright (c) 2026 wadackel
# SPDX-License-Identifier: MIT

description: |
  Plays one dax macro when the key is pressed and another when it is released, so a macro can
  hold a modifier or a layer for as long as the key is held. Both parameters are dax macro
  slots (CONFIG_ZMK_DAX_MACRO): `&dax_hold_macro <press slot> <release slot>`.

compatible: "dax,behavior-hold-macro"

include: two_param.yaml
```

## dts/bindings/behaviors/dax,behavior-runtime-macro.yaml
```yaml
# Copyright (c) 2026 wadackel
# SPDX-License-Identifier: MIT

description: |
  Plays the dax macro in a slot (CONFIG_ZMK_DAX_MACRO) when the key is pressed:
  `&dax_macro <slot>`. A play while another macro plays waits for it.

compatible: "dax,behavior-runtime-macro"

include: one_param.yaml
```

## dts/bindings/dax,runtime-combo-defaults.yaml
```yaml
# Copyright (c) 2026 cormoran
#
# SPDX-License-Identifier: MIT

description: |
  Compile-time defaults for the dax combos (CONFIG_ZMK_DAX_COMBO), adapted from
  cormoran/zmk-feature-runtime-combo at d9490e7. Each child node
  configures one runtime combo slot; the slot behaves exactly as if the same
  values had been written through the dax_combo Studio RPC, but is active
  immediately after flashing and survives a settings erase. A slot with a
  stored runtime value (written or explicitly deleted through the RPC) always
  overrides its default.

compatible: "dax,runtime-combo-defaults"

child-binding:
  description: A single default runtime combo.

  properties:
    key-positions:
      type: array
      required: true
      description: Key positions that make up the combo, same as zmk,combos.
    bindings:
      type: phandle-array
      required: true
      description: The single behavior binding invoked when the combo fires.
    layers:
      type: array
      description: Layers the combo is active on. Omit for all layers.
    slow-release:
      type: boolean
      description: Overrides the global slow-release setting to "on" for this combo.
    timeout-ms:
      type: int
      description: Overrides the global combo timeout for this combo. Omit to inherit.
    require-prior-idle-ms:
      type: int
      description: Overrides the global require-prior-idle setting for this combo. Omit to inherit.
    slot:
      type: int
      description: Runtime combo slot index. Defaults to the node's definition order.
    display-name:
      type: string
      description: Display name shown by a client such as daxial. Defaults to the node name.
```

## dts/bindings/dax,runtime-macro-defaults.yaml
```yaml
# Copyright (c) 2026 cormoran
#
# SPDX-License-Identifier: MIT

description: |
  Compile-time defaults for the dax macros (CONFIG_ZMK_DAX_MACRO), adapted from
  cormoran/zmk-feature-runtime-macro at 3853096. Each child node is the macro a
  slot shows until something is written to it through the dax_macro Studio RPC.
  Nothing is written at boot, and a reset shows the default again. A default
  cannot be deleted. A build takes one such node.

compatible: "dax,runtime-macro-defaults"

child-binding:
  description: A single default macro.

  properties:
    slot:
      type: int
      required: true
      description: The slot, the number `&dax_macro <slot>` plays.
    macro-name:
      type: string
      description: >
        The macro's name. Defaults to the node name. (Not `name`: devicetree keeps
        that for the node name.)
    bindings:
      type: phandle-array
      required: true
      description: >
        The steps, as a zmk,behavior-macro writes them: &macro_tap, &macro_press and
        &macro_release set how the bindings after them are played (tap at first),
        and &macro_wait_time <ms> waits. Taps of &kp with a keyboard usage from 0x04
        to 0x38, shifted or not, are packed one byte a key.
    wait-ms:
      type: int
      default: 0
      description: >
        A wait between consecutive steps that are not packed keys. 0 adds none.
```
