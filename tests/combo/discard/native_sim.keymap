#include <dt-bindings/zmk/keys.h>
#include <behaviors.dtsi>
#include <dt-bindings/zmk/kscan_mock.h>

/*
 * CONFIG_ZMK_DAX_COMBO_TEST_DISCARD (src/test/combo_test.c) writes two combos
 * to memory only and then discards:
 *
 *   combo 0: positions {0,1} -> key_press(B)
 *   combo 1: positions {2,3} -> key_press(C)
 *
 * The discard reverts both to empty slots, and the combo table is rebuilt
 * from the DISCARDED events. Positions 0-3 must therefore bubble through as
 * plain key presses.
 */

/ {
    keymap {
        compatible = "zmk,keymap";

        default_layer {
            bindings = <
            &kp K &kp L &kp M &kp N
            >;
        };
    };
};

&kscan {
    rows = <1>;
    columns = <4>;
    events = <
    ZMK_MOCK_PRESS(0,0,10)
    ZMK_MOCK_PRESS(0,1,10)
    ZMK_MOCK_RELEASE(0,0,10)
    ZMK_MOCK_RELEASE(0,1,10)

    ZMK_MOCK_PRESS(0,2,10)
    ZMK_MOCK_PRESS(0,3,10)
    ZMK_MOCK_RELEASE(0,2,10)
    ZMK_MOCK_RELEASE(0,3,10)
    >;
};
