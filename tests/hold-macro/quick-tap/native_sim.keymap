#include "../common.dtsi"

// Each tap lets go well inside the 30 ms the press macro holds TAB, so the release macro waits in
// the play queue. It must still run: the second tap, 10 ms later, must not overtake it, and the
// lone third tap must not leave GUI held. The idle key at position 3 only lets the keyboard settle
// after boot.
&kscan {
    events = <
        ZMK_MOCK_PRESS(1,1,300)
        ZMK_MOCK_RELEASE(1,1,300)
        ZMK_MOCK_PRESS(0,0,10)
        ZMK_MOCK_RELEASE(0,0,10)
        ZMK_MOCK_PRESS(0,0,10)
        ZMK_MOCK_RELEASE(0,0,200)
        ZMK_MOCK_PRESS(0,0,10)
        ZMK_MOCK_RELEASE(0,0,500)
    >;
};
